local &rows &cols &key &updated &start_time &end_time &elapsed_time
local &food_num &food_eaten &snake_length &snake_dir
local &keycode_quit &keycode_up &keycode_down &keycode_left &keycode_right
local &space_char &snake_head_char &snake_body_char &wall_char &food_char
local &space_int &snake_head_int &snake_body_int &wall_int &food_int

&keycode_quit="0071"
&keycode_up="006B"
&keycode_down="006A"
&keycode_left="0068"
&keycode_right="006C"

&space_char=" "
&snake_head_char="S"
&snake_body_char="s"
&wall_char="*"
&food_char="o"

&space_int=0.
&snake_head_int=1.
&snake_body_int=2.
&wall_int=3.
&food_int=4.
&snake_dir=0.

&rows=20.
&cols=40.
&key=""
&snake_length=5.
&food_num=20.
&food_eaten=0.

var.new int[&rows][&cols] \bitmap
var.new int[&snake_length][2] \snake_pos
var.new int[&food_num][2] \food_pos

winclear
area.reset
screen.off
area.create game &cols &rows
area.select game
area.view game

gosub initBitmap
gosub drawBitmap

//while "&key"!="&keycode_quit"
//(
//    inkey &key
//    if "&key"!=""
//    (
//        gosub updateSnakePos    
//    )
//    gosub drawBitmap
//)

&start_time=clock.unix()

game_loop_start:
    &updated=0.
    on time 500.ms goto game_loop_process
    inkey &key
    wait &updated==1

game_loop_process:
    gosub updateSnakePos
    gosub drawBitmap
    goto game_loop_start


quit_game:
    &end_time=clock.unix()
    print "quitting"
    screen.display
    &elapsed_time=&end_time-&start_time
    print "Time elapsed: &elapsed_time s"
    print "Food eaten: &food_eaten"
    enddo

drawBitmap:
    local &i
    local &j
    local &string

    area.clear
    &i=0.

    while &i<&rows
    (
        &j=0.
        &string=""
        while &j<&cols
        (
            if v.value(\bitmap[&i][&j])==&space_int
            (
                &string="&(string)&(space_char)"
            )
            if v.value(\bitmap[&i][&j])==&snake_head_int
            (
                &string="&(string)&(snake_head_char)"
            )
            if v.value(\bitmap[&i][&j])==&snake_body_int
            (
                &string="&(string)&(snake_body_char)"
            )
            if v.value(\bitmap[&i][&j])==&food_int
            (
                &string="&(string)&(food_char)"
            )
            if v.value(\bitmap[&i][&j])==&wall_int
            (
                &string="&(string)&(wall_char)"
            )
            &j=&j+1.
        )
        print "&string"
        &i=&i+1.
    )
    screen.display
    return
 
updateSnakePos:
    local &new_snake_head_row
    local &new_snake_head_col
    local &i &temp_row &temp_col &temp_val

    &new_snake_head_row=v.value(\snake_pos[0][0])
    &new_snake_head_col=v.value(\snake_pos[0][1])

    if "&key"=="&keycode_up"
    (
        &new_snake_head_row=&new_snake_head_row-1.
    )
    else if "&key"=="&keycode_down"
    (
        &new_snake_head_row=&new_snake_head_row+1.
    )
    else if "&key"=="&keycode_left"
    (
        &new_snake_head_col=&new_snake_head_col-1.
    )
    else if "&key"=="&keycode_right"
    (
        &new_snake_head_col=&new_snake_head_col+1.
    )
    else if "&key"=="&keycode_quit"
    (
        goto quit_game
    )
    else
    (
        return 0.
    )

    if &new_snake_head_row>=0.&&&new_snake_head_row<&rows
    (
        if &new_snake_head_col>=0.&&&new_snake_head_col<&cols
        (
            if v.value(\bitmap[&new_snake_head_row][&new_snake_head_col])==&food_int
            (
                var.set \bitmap[&new_snake_head_row][&new_snake_head_col]=&space_int
                &food_eaten=&food_eaten+1.
            )
            if v.value(\bitmap[&new_snake_head_row][&new_snake_head_col])==&space_int
            (
                // Add the head
                &temp_row=v.value(\snake_pos[0][0])
                &temp_col=v.value(\snake_pos[0][1])
                var.set \bitmap[&temp_row][&temp_col]=&snake_body_int
                var.set \bitmap[&new_snake_head_row][&new_snake_head_col]=&snake_head_int

                // Remove the tail
                &temp_row=v.value(\snake_pos[&snake_length-1.][0])
                &temp_col=v.value(\snake_pos[&snake_length-1.][1])
                var.set \bitmap[&temp_row][&temp_col]=&space_int

                &i=&snake_length-1.
                while &i>0.
                (
                    &temp_val=v.value(\snake_pos[&i-1.][0])
                    var.set \snake_pos[&i][0]=&temp_val

                    &temp_val=v.value(\snake_pos[&i-1.][1])
                    var.set \snake_pos[&i][1]=&temp_val

                    &i=&i-1.
                )
                var.set \snake_pos[0][0]=&new_snake_head_row
                var.set \snake_pos[0][1]=&new_snake_head_col

                return 1.
            )
        )
    )

    return -1.

initBitmap:
    local &i
    local &foodRow
    local &foodCol

    &i=0.
    while &i<&rows
    (
        var.set \bitmap[&i][0]=&wall_int
        var.set \bitmap[&i][&cols-1.]=&wall_int
        &i=&i+1.
    )

    &i=0.
    while &i<&cols
    (
        var.set \bitmap[0][&i]=&wall_int
        var.set \bitmap[&rows-1.][&i]=&wall_int
        &i=&i+1.
    )

    // Set up some barriers
    &i=0.
    while &i<15
    (
        var.set \bitmap[10][&i]=&wall_int
        var.set \bitmap[10][&cols-1.-&i]=&wall_int
        &i=&i+1.
    )

    // Set up the snake pos
    &i=0.
    while &i<&snake_length
    (
        var.set \snake_pos[&i][0]=5.
        var.set \snake_pos[&i][1]=10.-&i

        if &i==0.
        (
            var.set \bitmap[5][10.-&i]=&snake_head_int
        )
        else
        (
            var.set \bitmap[5][10.-&i]=&snake_body_int
        )

        &i=&i+1.
    )

    // Set up the food pos
    &i=0.
    while &i<&food_num
    (
        gosub randomNum 0 &rows
        entry &foodRow

        gosub randomNum 0 &cols
        entry &foodCol

        if v.value(\bitmap[&foodRow][&foodCol])==&space_int
        (
            var.set \food_pos[&i][0]=&foodRow
            var.set \food_pos[&i][1]=&foodCol
            var.set \bitmap[&foodRow][&foodCol]=&food_int
            &i=&i+1.
        )
    ) 
    return

randomNum:
    local &lower &upper &rand
    entry &lower &upper
    &rand=RANDOM()
    if &rand<0
    (
        &rand=&rand*-1.
    )
    &rand=&rand%&upper
    &rand=&rand+&lower
    return &rand

ENDDO

